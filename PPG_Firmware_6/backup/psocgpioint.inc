;  Generated by PSoC Designer 5.4.3191
;
; INT_Pin address and mask equates
INT_Pin_Data_ADDR:	equ	0h
INT_Pin_DriveMode_0_ADDR:	equ	100h
INT_Pin_DriveMode_1_ADDR:	equ	101h
INT_Pin_DriveMode_2_ADDR:	equ	3h
INT_Pin_GlobalSelect_ADDR:	equ	2h
INT_Pin_IntCtrl_0_ADDR:	equ	102h
INT_Pin_IntCtrl_1_ADDR:	equ	103h
INT_Pin_IntEn_ADDR:	equ	1h
INT_Pin_MASK:	equ	4h
; RxD address and mask equates
RxD_Data_ADDR:	equ	0h
RxD_DriveMode_0_ADDR:	equ	100h
RxD_DriveMode_1_ADDR:	equ	101h
RxD_DriveMode_2_ADDR:	equ	3h
RxD_GlobalSelect_ADDR:	equ	2h
RxD_IntCtrl_0_ADDR:	equ	102h
RxD_IntCtrl_1_ADDR:	equ	103h
RxD_IntEn_ADDR:	equ	1h
RxD_MASK:	equ	8h
; LED address and mask equates
LED_Data_ADDR:	equ	0h
LED_DriveMode_0_ADDR:	equ	100h
LED_DriveMode_1_ADDR:	equ	101h
LED_DriveMode_2_ADDR:	equ	3h
LED_GlobalSelect_ADDR:	equ	2h
LED_IntCtrl_0_ADDR:	equ	102h
LED_IntCtrl_1_ADDR:	equ	103h
LED_IntEn_ADDR:	equ	1h
LED_MASK:	equ	10h
; TxD address and mask equates
TxD_Data_ADDR:	equ	0h
TxD_DriveMode_0_ADDR:	equ	100h
TxD_DriveMode_1_ADDR:	equ	101h
TxD_DriveMode_2_ADDR:	equ	3h
TxD_GlobalSelect_ADDR:	equ	2h
TxD_IntCtrl_0_ADDR:	equ	102h
TxD_IntCtrl_1_ADDR:	equ	103h
TxD_IntEn_ADDR:	equ	1h
TxD_MASK:	equ	20h
; I2CHWSDA address and mask equates
I2CHWSDA_Data_ADDR:	equ	4h
I2CHWSDA_DriveMode_0_ADDR:	equ	104h
I2CHWSDA_DriveMode_1_ADDR:	equ	105h
I2CHWSDA_DriveMode_2_ADDR:	equ	7h
I2CHWSDA_GlobalSelect_ADDR:	equ	6h
I2CHWSDA_IntCtrl_0_ADDR:	equ	106h
I2CHWSDA_IntCtrl_1_ADDR:	equ	107h
I2CHWSDA_IntEn_ADDR:	equ	5h
I2CHWSDA_MASK:	equ	1h
; I2CHWSCL address and mask equates
I2CHWSCL_Data_ADDR:	equ	4h
I2CHWSCL_DriveMode_0_ADDR:	equ	104h
I2CHWSCL_DriveMode_1_ADDR:	equ	105h
I2CHWSCL_DriveMode_2_ADDR:	equ	7h
I2CHWSCL_GlobalSelect_ADDR:	equ	6h
I2CHWSCL_IntCtrl_0_ADDR:	equ	106h
I2CHWSCL_IntCtrl_1_ADDR:	equ	107h
I2CHWSCL_IntEn_ADDR:	equ	5h
I2CHWSCL_MASK:	equ	2h
